// GENERATED by scripts/sync_wokwi.py; edit canonical sources instead.

// Source: include/rover_control.h
#include <stdint.h>
#include <string.h>
#include <ctype.h>

namespace rover {
constexpr uint32_t MANUAL_MS = 1200, FRESH_MS = 500;
constexpr uint32_t SETTLE_MS = 180, TURN_MS = 540, NEUTRAL_MS = 100;
constexpr unsigned MAX_TURN_ATTEMPTS = 3;
constexpr int BLOCK_CM = 35, CLEAR_CM = 45, SIDE_STOP_CM = 20;
enum class Motion { Stop, Forward, Backward, Left, Right };
enum class NavPhase { Disarmed, Manual, Cruise, Settle, TurnPending, Turning, Reassess, Blocked, SensorFault, Emergency };
struct Range {
  int cm = -1;
  uint32_t at = 0;
  uint32_t sequence = 0;
  bool fresh(uint32_t now) const { return cm >= 2 && cm <= 400 && uint32_t(now-at) <= FRESH_MS; }
};
class Controller {
 public:
  bool armed = false, automatic = false, brushes = false, conveyor = false, estop = false;
  Motion motion = Motion::Stop;
  Range ranges[3]; // front, left, right
  void emergency() { estop = true; disarm(); }
  void disarm() {
    armed = automatic = brushes = conveyor = false;
    motion = Motion::Stop; phase = NavPhase::Cruise; turnAttempts = 0;
  }
  bool command(const char *cmd, uint32_t now, bool healthy) {
    if (!healthy) emergency();
    if (!strcmp(cmd,"ESTOP") || !strcmp(cmd,"STOP")) { emergency(); return true; }
    if (!strcmp(cmd,"DISARM")) { disarm(); return true; }
    if (!strcmp(cmd,"RESET")) {
      if (!healthy || armed) return false;
      estop = false; disarm(); return true;
    }
    if (!strcmp(cmd,"ARM")) {
      if (estop || !healthy) return false;
      disarm(); armed = true; return true;
    }
    if (!strcmp(cmd,"S")) {
      // Stop always exits AUTO, so it cannot resume on the next tick.
      automatic = false; motion = Motion::Stop; phase = NavPhase::Cruise; turnAttempts = 0; return true;
    }
    if (!strcmp(cmd,"MANUAL")) {
      automatic = false; motion = Motion::Stop; phase = NavPhase::Cruise; turnAttempts = 0; return true;
    }
    if (!strcmp(cmd,"CLEAN OFF")) { brushes = conveyor = false; return true; }
    if (!strcmp(cmd,"BRUSH OFF")) { brushes = false; return true; }
    if (!strcmp(cmd,"CONVEYOR OFF")) { conveyor = false; return true; }
    if (!armed || estop) return false;
    if (!strcmp(cmd,"CLEAN ON")) { brushes = conveyor = true; return true; }
    if (!strcmp(cmd,"BRUSH ON")) { brushes = true; return true; }
    if (!strcmp(cmd,"CONVEYOR ON")) { conveyor = true; return true; }
    if (!strcmp(cmd,"AUTO")) {
      if (!valid(now)) return false;
      automatic = true; motion = Motion::Stop; phase = NavPhase::Cruise; turnAttempts = 0; return true;
    }
    if (automatic) return false;
    Motion next;
    if (!strcmp(cmd,"F")) next = Motion::Forward;
    else if (!strcmp(cmd,"B")) next = Motion::Backward;
    else if (!strcmp(cmd,"L")) next = Motion::Left;
    else if (!strcmp(cmd,"R")) next = Motion::Right;
    else return false;
    motion = next; manualAt = now; return true;
  }
  void sample(unsigned sensor, int cm, uint32_t now) {
    if (sensor < 3) {
      ranges[sensor].cm = cm; ranges[sensor].at = now; ++ranges[sensor].sequence;
    }
  }
  bool valid(uint32_t now) const {
    return ranges[0].fresh(now) && ranges[1].fresh(now) && ranges[2].fresh(now);
  }
  bool brushOutput() const { return armed && !estop && brushes && motion == Motion::Forward; }
  bool conveyorOutput() const { return armed && !estop && conveyor && motion == Motion::Forward; }
  bool cleanOutput() const { return brushOutput() && conveyorOutput(); }
  NavPhase navigation() const {
    if (estop) return NavPhase::Emergency;
    if (phase == NavPhase::Blocked || phase == NavPhase::SensorFault) return phase;
    if (!armed) return NavPhase::Disarmed;
    return automatic ? phase : NavPhase::Manual;
  }
  const char *navigationName() const {
    switch (navigation()) {
      case NavPhase::Disarmed: return "DISARMED";
      case NavPhase::Manual: return "MANUAL";
      case NavPhase::Cruise: return "CRUISE";
      case NavPhase::Settle: return "SETTLE";
      case NavPhase::TurnPending: return "TURN_DEAD_TIME";
      case NavPhase::Turning: return "TURNING";
      case NavPhase::Reassess: return "REASSESS";
      case NavPhase::Blocked: return "TURN_LIMIT";
      case NavPhase::SensorFault: return "SENSOR_FAULT";
      default: return "ESTOP";
    }
  }
  // Called only after the adapter has applied PWM and permitted EN. This is
  // software output feedback, not an encoder or proof of physical movement.
  void reportApplied(Motion applied, uint32_t now) {
    if (armed && automatic && !estop && phase == NavPhase::TurnPending && applied == motion) {
      phase = NavPhase::Turning; phaseAt = now;
    }
  }
  void tick(uint32_t now, bool healthy) {
    if (!healthy) emergency();
    if (!armed || estop) { motion = Motion::Stop; return; }
    if (!automatic) {
      if (motion != Motion::Stop && uint32_t(now-manualAt) >= MANUAL_MS) motion = Motion::Stop;
      return;
    }
    // A missing/stale sensor latches a disarm; fresh readings alone never restart.
    if (!valid(now)) { disarm(); phase = NavPhase::SensorFault; return; }
    const int front = ranges[0].cm, left = ranges[1].cm, right = ranges[2].cm;
    if (phase == NavPhase::TurnPending || phase == NavPhase::Turning) {
      const int turningSide = motion == Motion::Left ? left : right;
      if ((phase == NavPhase::Turning && uint32_t(now-phaseAt) >= TURN_MS) || turningSide <= CLEAR_CM ||
          left <= SIDE_STOP_CM || right <= SIDE_STOP_CM) {
        beginReassessment(now);
      }
      return;
    }
    if (phase == NavPhase::Settle || phase == NavPhase::Reassess) {
      motion = Motion::Stop;
      if (uint32_t(now-phaseAt) < SETTLE_MS) return;
      // After a turn, never use the same pre-stop readings for another turn
      // or for forward recovery. Versions also work at millis() rollover.
      if (phase == NavPhase::Reassess) {
        for (unsigned i=0;i<3;++i) if (ranges[i].sequence == reassessSequence[i]) return;
      }
      // Hysteresis: enter avoidance at 35 cm, leave it only above 45 cm.
      if (front > CLEAR_CM && left > SIDE_STOP_CM && right > SIDE_STOP_CM) {
        phase = NavPhase::Cruise; motion = Motion::Forward; turnAttempts = 0; return;
      }
      if (turnAttempts >= MAX_TURN_ATTEMPTS) {
        disarm(); phase = NavPhase::Blocked; return;
      }
      if (left > SIDE_STOP_CM && right > SIDE_STOP_CM && (left > CLEAR_CM || right > CLEAR_CM)) {
        motion = left >= right ? Motion::Left : Motion::Right;
        phase = NavPhase::TurnPending; ++turnAttempts;
      }
      return;
    }
    if (front <= BLOCK_CM || left <= SIDE_STOP_CM || right <= SIDE_STOP_CM) {
      motion = Motion::Stop; phase = NavPhase::Settle; phaseAt = now;
    } else motion = Motion::Forward;
  }
 private:
  void beginReassessment(uint32_t now) {
    motion = Motion::Stop; phase = NavPhase::Reassess; phaseAt = now;
    for (unsigned i=0;i<3;++i) reassessSequence[i] = ranges[i].sequence;
  }
  NavPhase phase = NavPhase::Cruise;
  uint32_t phaseAt = 0, manualAt = 0;
  uint32_t reassessSequence[3] = {};
  unsigned turnAttempts = 0;
};

// A bounded line parser; an overlong line is discarded in full, never truncated
// into a valid command. The caller must disarm on overflow.
class LineParser {
 public:
  enum Result { None, Ready, Overflow };
  Result feed(char ch) {
    if (ch == '\r' || ch == '\n') {
      if (discard) { discard = false; used = 0; return None; }
      buffer[used] = 0;
      while (used && isspace(static_cast<unsigned char>(buffer[used-1]))) buffer[--used] = 0;
      unsigned start = 0;
      while (buffer[start] && isspace(static_cast<unsigned char>(buffer[start]))) ++start;
      if (start) memmove(buffer,buffer+start,used-start+1);
      bool hasText = buffer[0] != 0; used = 0;
      return hasText ? Ready : None;
    }
    if (discard) return None;
    if (used == sizeof(buffer)-1 || (static_cast<unsigned char>(ch) < 32 && ch != '\t')) {
      discard = true; used = 0; return Overflow;
    }
    buffer[used++] = static_cast<char>(toupper(static_cast<unsigned char>(ch)));
    return None;
  }
  const char *line() const { return buffer; }
 private:
  char buffer[49] = {};
  unsigned used = 0;
  bool discard = false;
};

// Disable every driver for a neutral interval before any new motion. This is
// electrical interlocking, not proof that a loaded motor has stopped rotating.
class MotionGate {
 public:
  Motion update(Motion requested, uint32_t now) {
    if (requested != target) { target = requested; at = now; actual = Motion::Stop; }
    if (target == Motion::Stop) actual = Motion::Stop;
    else if (uint32_t(now-at) >= NEUTRAL_MS) actual = target;
    return actual;
  }
 private:
  Motion target = Motion::Stop, actual = Motion::Stop;
  uint32_t at = 0;
};
} // namespace rover

// Source: include/rover_pins.h
namespace pins {
constexpr int L_FWD=16, L_REV=17, R_FWD=18, R_REV=19;
constexpr int TF=32, EF=34, TL=33, EL=35, TR=13, ER=36;
// One L298N: channel A drives both brushes; channel B drives the conveyor.
constexpr int BRUSH_IN1=21, BRUSH_IN2=22, CONVEYOR_IN3=23, CONVEYOR_IN4=25;
constexpr int ENABLE=14, ESTOP_OK=27;
constexpr int PWM[] = {L_FWD,L_REV,R_FWD,R_REV};
constexpr int AUX[] = {BRUSH_IN1,BRUSH_IN2,CONVEYOR_IN3,CONVEYOR_IN4};
constexpr int TRIG[] = {TF,TL,TR};
constexpr int ECHO[] = {EF,EL,ER};
}

// Source: include/rover_telemetry.h
#include <stdio.h>
namespace rover {
constexpr const char *FIRMWARE_ID="rover-usb-v1";
// Adapter-supplied output state: never claims encoders or physical movement.
inline int telemetry(char *out,unsigned capacity,const Controller &c,uint32_t now,
                     Motion applied,bool enabled,bool brush,bool conveyor,bool healthy) {
  return snprintf(out,capacity,
    "TEL {\"v\":1,\"fw\":\"%s\",\"ms\":%lu,\"armed\":%s,\"auto\":%s,\"estop\":%s,\"healthy\":%s,"
    "\"requested\":%d,\"applied\":%d,\"en\":%s,\"brushReq\":%s,\"conveyorReq\":%s,\"brush\":%s,\"conveyor\":%s,"
    "\"nav\":\"%s\",\"cm\":[%d,%d,%d],\"age\":[%lu,%lu,%lu]}",
    FIRMWARE_ID,static_cast<unsigned long>(now),c.armed?"true":"false",c.automatic?"true":"false",c.estop?"true":"false",healthy?"true":"false",
    static_cast<int>(c.motion),static_cast<int>(applied),enabled?"true":"false",c.brushes?"true":"false",c.conveyor?"true":"false",brush?"true":"false",conveyor?"true":"false",c.navigationName(),
    c.ranges[0].cm,c.ranges[1].cm,c.ranges[2].cm,
    static_cast<unsigned long>(uint32_t(now-c.ranges[0].at)),static_cast<unsigned long>(uint32_t(now-c.ranges[1].at)),static_cast<unsigned long>(uint32_t(now-c.ranges[2].at)));
}
}

// Source: firmware/rover.ino
// Canonical ESP32 firmware. No motor/battery power is needed for software tests.
#include <Arduino.h>
#include <esp_arduino_version.h>
#include <soc/soc.h>
#include <soc/gpio_reg.h>

rover::Controller controller;
rover::LineParser parser;
rover::MotionGate gate;
volatile bool hardwareTrip = false;
portMUX_TYPE safetyMux = portMUX_INITIALIZER_UNLOCKED;
bool pwmReady = true;
uint32_t lastPing = 0, lastLog = 0;
unsigned sensorIndex = 0;
rover::Motion appliedMotion = rover::Motion::Stop;
bool appliedEnable = false, appliedBrush = false, appliedConveyor = false;

void IRAM_ATTR stopInterrupt() {
  // GPIO14 is below 32. Cut EN even during pulseIn; the physical power cutoff
  // remains mandatory. Main-loop EN writes use the same critical section.
  portENTER_CRITICAL_ISR(&safetyMux);
  REG_WRITE(GPIO_OUT_W1TC_REG, 1UL << pins::ENABLE);
  hardwareTrip = true;
  portEXIT_CRITICAL_ISR(&safetyMux);
}
bool healthy() { return digitalRead(pins::ESTOP_OK) == HIGH; }
void pwmWrite(unsigned channel, unsigned duty) {
#if ESP_ARDUINO_VERSION_MAJOR >= 3
  ledcWrite(pins::PWM[channel], duty);
#else
  ledcWrite(channel, duty);
#endif
}
void zeroOutputs() {
  digitalWrite(pins::ENABLE, LOW);
  for (unsigned i=0;i<4;++i) pwmWrite(i,0);
  for (int p : pins::AUX) digitalWrite(p,LOW);
}
void applyOutputs(uint32_t now) {
  rover::Motion request = controller.armed && !controller.estop && pwmReady ? controller.motion : rover::Motion::Stop;
  rover::Motion actual = gate.update(request,now);
  // Only rewrite direction channels on a change: avoid transient opposite
  // bridge states and unnecessary PWM resets on every loop iteration.
  static rover::Motion previous = rover::Motion::Stop;
  if (actual != previous || actual == rover::Motion::Stop) {
    zeroOutputs();
    if (actual == rover::Motion::Forward) { pwmWrite(0,150); pwmWrite(2,150); }
    if (actual == rover::Motion::Backward) { pwmWrite(1,150); pwmWrite(3,150); }
    if (actual == rover::Motion::Left) { pwmWrite(1,140); pwmWrite(2,140); }
    if (actual == rover::Motion::Right) { pwmWrite(0,140); pwmWrite(3,140); }
    previous = actual;
  }
  bool brush = actual == rover::Motion::Forward && controller.brushOutput();
  bool conveyor = actual == rover::Motion::Forward && controller.conveyorOutput();
  digitalWrite(pins::BRUSH_IN1,brush); digitalWrite(pins::BRUSH_IN2,LOW);
  digitalWrite(pins::CONVEYOR_IN3,conveyor); digitalWrite(pins::CONVEYOR_IN4,LOW);
  portENTER_CRITICAL(&safetyMux);
  bool permit = actual != rover::Motion::Stop && !hardwareTrip && healthy() && pwmReady;
  digitalWrite(pins::ENABLE,permit ? HIGH : LOW);
  portEXIT_CRITICAL(&safetyMux);
  if (!permit) zeroOutputs();
  // Event telemetry exposes applied outputs, including the neutral interval,
  // so short turns and independently requested auxiliaries can be inspected.
  rover::Motion reported = permit ? actual : rover::Motion::Stop;
  controller.reportApplied(reported,now);
  appliedMotion = reported; appliedEnable = permit;
  appliedBrush = permit && brush; appliedConveyor = permit && conveyor;
  int outputs = static_cast<int>(reported)*4 + (permit && brush ? 2 : 0) + (permit && conveyor ? 1 : 0);
  int state = outputs*16 + static_cast<int>(controller.navigation());
  static int previousState = -1;
  if (state != previousState) {
    previousState = state;
    const char *names[] = {"STOPPED","FORWARD","BACKWARD","LEFT","RIGHT"};
    Serial.printf("STATE motion=%s en=%d brush=%d conveyor=%d nav=%s ms=%lu\n",names[static_cast<int>(reported)],
      permit,permit && brush,permit && conveyor,controller.navigationName(),static_cast<unsigned long>(now));
  }
}
int measure(unsigned index) {
  digitalWrite(pins::TRIG[index],LOW); delayMicroseconds(2);
  digitalWrite(pins::TRIG[index],HIGH); delayMicroseconds(10);
  digitalWrite(pins::TRIG[index],LOW);
  unsigned long us = pulseIn(pins::ECHO[index],HIGH,25000);
  int cm = static_cast<int>(us/58UL);
  return cm>=2 && cm<=400 ? cm : -1;
}
void setup() {
  // Firmware holds EN low after setup begins. Reset/power-ramp safety still
  // requires verified driver input defaults or external pulls (not on hand).
  digitalWrite(pins::ENABLE,LOW); pinMode(pins::ENABLE,OUTPUT);
  for (int p : pins::AUX) { digitalWrite(p,LOW); pinMode(p,OUTPUT); }
  for (int p : pins::TRIG) { digitalWrite(p,LOW); pinMode(p,OUTPUT); }
  for (int p : pins::ECHO) pinMode(p,INPUT);
  // GPIO27 supports an internal pull-down: an open NC contact reads unsafe.
  pinMode(pins::ESTOP_OK,INPUT_PULLDOWN);
  attachInterrupt(digitalPinToInterrupt(pins::ESTOP_OK),stopInterrupt,FALLING);
  if (!healthy()) { hardwareTrip = true; controller.emergency(); }
  for (unsigned i=0;i<4;++i) {
    digitalWrite(pins::PWM[i],LOW); pinMode(pins::PWM[i],OUTPUT);
#if ESP_ARDUINO_VERSION_MAJOR >= 3
    if (!ledcAttach(pins::PWM[i],1200,8)) pwmReady = false;
#else
    if (ledcSetup(i,1200,8) == 0) pwmReady = false;
    ledcAttachPin(pins::PWM[i],i);
#endif
  }
  zeroOutputs();
  Serial.begin(115200);
  Serial.println("READY DISARMED; RESET after ESTOP, then ARM. Motor power stays disconnected for software tests.");
  if (!pwmReady) Serial.println("FAULT PWM setup; arming disabled");
}
void loop() {
  if (hardwareTrip || !healthy()) controller.emergency();
  controller.tick(millis(),healthy());
  applyOutputs(millis());
  // Bounded serial work prevents input flooding from starving the deadman.
  for (unsigned count=0;count<64 && Serial.available();++count) {
    rover::LineParser::Result result = parser.feed(static_cast<char>(Serial.read()));
    if (result == rover::LineParser::Overflow) {
      controller.disarm(); applyOutputs(millis()); Serial.println("ERR line overflow; DISARMED");
    } else if (result == rover::LineParser::Ready) {
      bool accepted;
      portENTER_CRITICAL(&safetyMux);
      if (hardwareTrip) controller.emergency();
      accepted = controller.command(parser.line(),millis(),healthy() && pwmReady);
      if (accepted && !strcmp(parser.line(),"RESET")) hardwareTrip = false;
      portEXIT_CRITICAL(&safetyMux);
      applyOutputs(millis());
      Serial.printf("%s %s\n",accepted ? "OK" : "ERR",parser.line());
    }
  }
  // One ping every 65 ms; no 45/180 ms blocking delays. Serial stop latency
  // can still be up to one 25 ms pulseIn timeout plus loop/serial overhead.
  uint32_t now = millis();
  if (uint32_t(now-lastPing) >= 65) {
    lastPing = now;
    int cm = measure(sensorIndex);
    controller.sample(sensorIndex,cm,millis());
    sensorIndex = (sensorIndex+1)%3;
  }
  if (hardwareTrip) controller.emergency();
  controller.tick(millis(),healthy());
  applyOutputs(millis());
  now = millis();
  if (uint32_t(now-lastLog) >= 500 && Serial.availableForWrite() >= 100) {
    lastLog = now;
    char message[512];
    int length = rover::telemetry(message,sizeof(message),controller,now,appliedMotion,
      appliedEnable,appliedBrush,appliedConveyor,healthy());
    if (length > 0 && length < static_cast<int>(sizeof(message))) Serial.println(message);
    Serial.printf("DIST %d %d %d armed=%d auto=%d estop=%d motion=%d en=%d\n",
      controller.ranges[0].cm,controller.ranges[1].cm,controller.ranges[2].cm,
      controller.armed,controller.automatic,controller.estop,static_cast<int>(controller.motion),digitalRead(pins::ENABLE));
  }
}
